## boards/arm/altar_i/Kconfig.board
```kconfig
# Copyright (c) 2025 Electronic Materials Office Ltd.
# SPDX-License-Identifier: MIT

config BOARD_ALTAR_I_US
    bool "Altar I Keyboard (US Layout)"
    depends on SOC_NRF52840_QIAA

config BOARD_ALTAR_I_UK
    bool "Altar I Keyboard (UK Layout)"
    depends on SOC_NRF52840_QIAA
```

## boards/arm/altar_i/Kconfig.defconfig
```kconfig
# Copyright (c) 2025 Electronic Materials Office Ltd.
# SPDX-License-Identifier: MIT

if (BOARD_ALTAR_I_US || BOARD_ALTAR_I_UK)

config BOARD
    default "altar_i_us" if BOARD_ALTAR_I_US
    default "altar_i_uk" if BOARD_ALTAR_I_UK

config ZMK_KEYBOARD_NAME
    default "Altar I"

if USB

config USB_NRFX
    default y

config USB_DEVICE_STACK
    default y

endif # USB

config BT_CTLR
    default BT

endif # (BOARD_ALTAR_I_US || BOARD_ALTAR_I_UK)
```

## boards/arm/altar_i/altar_i_us_defconfig
```kconfig
# Copyright (c) 2025 Electronic Materials Office Ltd.
# SPDX-License-Identifier: MIT

CONFIG_SOC_SERIES_NRF52X=y
CONFIG_SOC_NRF52840_QIAA=y
CONFIG_BOARD_ALTAR_I_US=y

# Enable MPU
CONFIG_ARM_MPU=y

# Enable GPIO
CONFIG_PINCTRL=y
CONFIG_GPIO=y
CONFIG_ADC=y

CONFIG_ZMK_USB=y
CONFIG_ZMK_BLE=y

# Enable the rotary encoder
CONFIG_EC11=y
CONFIG_EC11_TRIGGER_GLOBAL_THREAD=y

# Enable encoder sleep modes
CONFIG_ZMK_EC11_AUTO_OFF=y
CONFIG_ZMK_EC11_AUTO_OFF_IDLE=y
#CONFIG_ZMK_EC11_AUTO_OFF_SLEEP=y

# Enable LEDs
CONFIG_LED=y
CONFIG_LED_PWM=y
CONFIG_PWM=y
CONFIG_ZMK_HID_INDICATORS=y

# Boost Bluetooth power
CONFIG_BT_CTLR_TX_PWR_PLUS_8=y

# Enable and set deep sleep time
CONFIG_ZMK_SLEEP=y
CONFIG_ZMK_IDLE_SLEEP_TIMEOUT=900000
CONFIG_ZMK_BATTERY_REPORT_INTERVAL=180

CONFIG_USE_DT_CODE_PARTITION=y
CONFIG_BUILD_OUTPUT_UF2=y

CONFIG_MPU_ALLOW_FLASH_WRITE=y
CONFIG_NVS=y
CONFIG_SETTINGS_NVS=y
CONFIG_FLASH=y
CONFIG_FLASH_PAGE_LAYOUT=y
CONFIG_FLASH_MAP=y

# Windows Battery Reporting Fix
CONFIG_BT_GATT_ENFORCE_SUBSCRIPTION=n
```

## src/behaviors/Kconfig
```kconfig
# Copyright (c) 2025 The ZMK Contributors
# SPDX-License-Identifier: MIT

menuconfig ZMK_EC11_AUTO_OFF
    bool "Turn off rotary encoders automatically depending on ZMK state"
    default y

if ZMK_EC11_AUTO_OFF

config ZMK_EC11_AUTO_OFF_IDLE
    bool "Turn off rotary encoders when keyboard goes into idle state"
    default n

config ZMK_EC11_AUTO_OFF_SLEEP
    bool "Turn off rotary encoders when keyboard goes into sleep state"
    default n

endif # ZMK_EC11_AUTO_OFF
```
